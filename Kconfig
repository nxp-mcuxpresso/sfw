## component/Kconfig
```kconfig
menu "MCU SFW Component"

source "$SFW_DIR/component/flashiap/Kconfig"

source "$SFW_DIR/component/secure/Kconfig"

source "$SFW_DIR/component/serial_manager/Kconfig"

endmenu
```

## component/secure/Kconfig
```kconfig
menu "secure"
    menuconfig COMPONENT_MCUBOOT_SECURE
        config CONFIG_BOOT_ENCRYPTED_XIP
            bool "Encrypted XIP function"
            default n
            help
                Use encrypted application image.
        depends on (SOC_IMXRTYYYY_SERIES || SOC_IMXRTXXX_SERIES)

        config COMPONENT_MBEDTLS
            bool "enable mbedtls"
            default y
            help
                enable mbedtls.
		
    	if COMPONENT_MBEDTLS
    	    config SFW_MBEDTLS_CONFIG_FILE
    	        string "Set mbedtls config file"
    	        default "ksdk_mbedtls_config.h"
    	        help
    	            Set the specific mbedtls config file.
    	endif
endmenu
```

## component/usb/Kconfig
```kconfig
menu "udisk updating mode"

config COMPONENT_USB
    bool "Enable udisk updating mode"
    default n
    select COMPONENT_OSA
    help
        Enable udisk updating mode.

config COMPONENT_OSA
    bool
endmenu
```

## firmware/Kconfig
```kconfig
menu "MCU SFW core"
		
config SFW_STANDALONE_XIP
    bool "Enable sfw standalone xip"
    default n
    help
        If enable, the SFW image can run in XIP separately.
        If disable, the SFW image must be used in conjunction with SBL.

config SFW_RTOS_FREERTOS
    bool
    default y

config OTA_SUPPORT
    bool "Enable OTA"
    default n

if OTA_SUPPORT

    if !(SOC_IMXRT1010_SERIES || SOC_LPC55S69_SERIES || SOC_IMXRT500_SERIES || SOC_IMXRT600_SERIES)
        config OTA_CLOUD
	        bool "OTA from cloud"
		    default n

	    if OTA_CLOUD
            choice
                prompt "OTA Cloud Select"
                default OTA_ALIYUN

                config OTA_ALIYUN
                    bool "Aliyun"

                config OTA_AWS
                    bool "AWS"
            endchoice

            if OTA_AWS
                menu "AWS Config"
                    config MQTT_BROKER_ENDPOINT
                        string "Set MQTT broker DNS name"
                        default ""

                    config IOT_THING_NAME
                        string "Set IoT Thing name"
                        default ""
                endmenu
            endif

            if OTA_ALIYUN
                menu "Aliyun Config"
                    config PRODUCT_KEY
                        string "Set product key"
                        default ""

                    config DEVICE_NAME
                        string "Set device name"
                        default ""

                    config DEVICE_SECRET
                        string "Set device secret"
                        default ""
                endmenu
            endif
        endif
    endif

    if !(SOC_IMXRT1010_SERIES)
        config OTA_SDCARD
            bool "OTA from sdcard"
            default y
		    select COMPONENT_FS
		    select COMPONENT_SDMMC
		    select COMPONENT_OSA

        config COMPONENT_SDMMC
            bool
		    select SOC_GPIO
    endif

    config OTA_UDISK
        bool "OTA from u-disk"
		default n
		select COMPONENT_FS
		select COMPONENT_USB
		select COMPONENT_OSA

    config COMPONENT_FS
        bool

    config COMPONENT_USB
        bool

    config COMPONENT_OSA
        bool

endif

menu "MCU SFW Flash Map"

config BOOT_FLASH_BASE
    hex "Flash base address"
    default 0x60000000
    help
        The base address of the flash.

config BOOT_FLASH_HEADER
    hex "Metadata header address"
    default 0x60010000
    help
        The metadata header address.

config BOOT_FLASH_ACT_APP
    hex "Active APP start address"
    default 0x60100000
    help
        The active application start address.

config BOOT_FLASH_CAND_APP
    hex "Candidate APP start address"
    default 0x60200000
    help
        The candidate application start address.

config BOOT_FLASH_CUSTOMER
    hex "Customer space start address"
    default 0x603f0000
    help
        The customer space start address.
endmenu

endmenu
```

## target/evkbmimxrt1050/Kconfig
```kconfig
mainmenu "MCU-SFW RT1050 Configuration"

config SFW_DIR
    string
    option env="SFW_ROOT"
    default "../../"

config SOC_IMXRT1050_SERIES
    bool
    select ARCH_ARM_CORTEX_M7
    select ARCH_ARM_CORTEX_FPU
	select SOC_IMXRTYYYY_SERIES

config ARCH_ARM_CORTEX_M7
    bool

config ARCH_ARM_CORTEX_FPU
    bool

config SOC_IMXRTYYYY_SERIES
    bool

source "$SFW_DIR/Kconfig"
menu "Platform Drivers Config"

config BOARD_FLASH_SUPPORT
    bool "Board flash support"
    default y
    help
        Select the flash board used.

if BOARD_FLASH_SUPPORT
    choice
        prompt "Select the flash"
        default Cypress_S26KSxxxS

        config ISSI_AT25SFxxxA
            bool "ISSI_AT25SFxxxA Flash"
            select SOC_FLEXSPI
            select SOC_FLEXSPI_1

        config ISSI_IS25LPxxxA
            bool "ISSI_IS25LPxxxA Flash"
            select SOC_FLEXSPI
            select SOC_FLEXSPI_1
			
        config Cypress_S26KSxxxS
            bool "Cypress_S26KSxxxS Flash"
            select SOC_FLEXSPI
            select SOC_FLEXSPI_1

        config ISSI_IS25WPxxxA
            bool "ISSI_IS25WPxxxA Flash"
            select SOC_FLEXSPI
            select SOC_FLEXSPI_1

        config WINBOND_W25QxxxJV
            bool "WINBOND_W25QxxxJV Flash"
            select SOC_FLEXSPI
            select SOC_FLEXSPI_1

        config Macronix_MX25UM51345G
            bool "Macronix_MX25UM51345G Flash"
            select SOC_FLEXSPI
            select SOC_FLEXSPI_1

        config Macronix_MX25UM51345G_2nd
            bool "Macronix_MX25UM51345G_2nd Flash"
            select SOC_FLEXSPI
            select SOC_FLEXSPI_1

    endchoice
endif

config SOC_MIMXRT1052DVL6B
    bool
    select SOC_IMXRT1050_SERIES
    default y

menu "On-chip Peripheral Drivers"

    config SOC_GPIO
        bool "Enable GPIO"
        default n

    menuconfig SOC_LPUART
        bool "Enable UART"
        default y
        if SOC_LPUART
            config SOC_LPUART_1
                bool "Enable LPUART1"
                default y
            config SOC_LPUART_2
                bool "Enable LPUART2"
                default n
        endif

    config SOC_FLEXSPI
        bool "Enable FlexSPI"
        default n
        if SOC_FLEXSPI
            config SOC_FLEXSPI_1
                bool "Enable FlexSPI1"
                default y
            config SOC_FLEXSPI_2
                bool "Enable FlexSPI2"
                default n
	endif
endmenu

menu "Onboard Peripheral Drivers"

    config BOARD_SDRAM
        bool "Enable SDRAM"
        default n

    config BOARD_ENET
        bool "Enable Ethernet"
        default y if OTA_CLOUD
        select COMPONENT_PHY

    config COMPONENT_PHY
        bool

endmenu

menu "Board extended module Drivers"

    config MODULE_WIFI
        bool "Enable Wifi Module"
        default n

endmenu

endmenu
```
